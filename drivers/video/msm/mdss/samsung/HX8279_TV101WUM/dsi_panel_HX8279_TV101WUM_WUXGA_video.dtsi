/* Copyright (c) 2013-14, Samsung Electronics Corporation. All rights reserved.
 *
 * This program is free software; you can redistribute it and/or modify
 * it under the terms of the GNU General Public License version 2 and
 * only version 2 as published by the Free Software Foundation.
 *
 * This program is distributed in the hope that it will be useful,
 * but WITHOUT ANY WARRANTY; without even the implied warranty of
 * MERCHANTABILITY or FITNESS FOR A PARTICULAR PURPOSE.  See the
 * GNU General Public License for more details.
 */

/*---------------------------------------------------------------------------
 * This file is autogenerated file using gcdb parser. Please do not edit it.
 * Update input XML file to add a new entry or update variable in this file
 * VERSION = "1.0"
 *---------------------------------------------------------------------------*/
&mdss_mdp {
	ss_dsi_panel_HX8279_TV101WUM_WUXGA: ss_dsi_panel_HX8279_TV101WUM_WUXGA {
		qcom,mdss-dsi-panel-name = "ss_dsi_panel_HX8279_TV101WUM_WUXGA";
		qcom,mdss-dsi-panel-controller = <&mdss_dsi0>;
		qcom,mdss-dsi-panel-width = <1200>;
		qcom,mdss-dsi-panel-height = <1920>;
		qcom,mdss-dsi-bpp = <24>;
		qcom,mdss-dsi-panel-destination = "display_1";

		qcom,mdss-dsi-h-pulse-width = <24>;
		qcom,mdss-dsi-h-back-porch = <46>;
		qcom,mdss-dsi-h-front-porch = <20>;

		qcom,mdss-dsi-h-sync-skew = <0>;
		qcom,mdss-dsi-v-pulse-width = <1>;
		qcom,mdss-dsi-v-back-porch = <13>;
		qcom,mdss-dsi-v-front-porch = <30>;

		qcom,mdss-dsi-t-clk-post = <0x0D>;
		qcom,mdss-dsi-t-clk-pre = <0x30>;

		qcom,mdss-dsi-panel-clockrate = <912080000>;

		qcom,mdss-pan-physical-width-dimension = <141>;
		qcom,mdss-pan-physical-height-dimension = <226>;
		qcom,mdss-dsi-on-command-state = "dsi_lp_mode";
		qcom,mdss-dsi-off-command-state = "dsi_lp_mode";
		qcom,mdss-dsi-panel-framerate = <60>;
		qcom,mdss-dsi-reset-sequence = <0 7>, <1 7>;

		qcom,mdss-dsi-panel-timings-phy-v2 = [
			24 1F 08 09 05 03 04 a0
			24 1F 08 09 05 03 04 a0
			24 1F 08 09 05 03 04 a0
			24 1F 08 09 05 03 04 a0
			24 1B 08 09 05 03 04 a0];

		qcom,mdss-dsi-on-command = [
/*page 1: GOA MUX setting*/
			39 01 00 00 00 00 02 B0 01
			39 01 00 00 00 00 02 E0 26
			39 01 00 00 00 00 02 E1 26
			39 01 00 00 00 00 02 DC 00
			39 01 00 00 00 00 02 DD 00
			39 01 00 00 00 00 02 CC 26
			39 01 00 00 00 00 02 CD 26
			39 01 00 00 00 00 02 C8 00
			39 01 00 00 00 00 02 C9 00
			39 01 00 00 00 00 02 D2 03
			39 01 00 00 00 00 02 D3 03
			39 01 00 00 00 00 02 E6 04
			39 01 00 00 00 00 02 E7 04
			39 01 00 00 00 00 02 C4 09
			39 01 00 00 00 00 02 C5 09
			39 01 00 00 00 00 02 D8 0A
			39 01 00 00 00 00 02 D9 0A
			39 01 00 00 00 00 02 C2 0B
			39 01 00 00 00 00 02 C3 0B
			39 01 00 00 00 00 02 D6 0C
			39 01 00 00 00 00 02 D7 0C
			39 01 00 00 00 00 02 C0 05
			39 01 00 00 00 00 02 C1 05
			39 01 00 00 00 00 02 D4 06
			39 01 00 00 00 00 02 D5 06
			39 01 00 00 00 00 02 CA 07
			39 01 00 00 00 00 02 CB 07
			39 01 00 00 00 00 02 DE 08
			39 01 00 00 00 00 02 DF 08
/*Page 3: GOA timing setting*/
			39 01 00 00 00 00 02 B0 03
			39 01 00 00 00 00 02 C8 0B
			39 01 00 00 00 00 02 C9 07
			39 01 00 00 00 00 02 C3 00
			39 01 00 00 00 00 02 E7 00
			39 01 00 00 00 00 02 C5 2A
			39 01 00 00 00 00 02 DE 2A
			39 01 00 00 00 00 02 CA 43
			39 01 00 00 00 00 02 C9 07
			39 01 00 00 00 00 02 E4 C0
			39 01 00 00 00 00 02 E5 0D
			39 01 00 00 00 00 02 CB 00
/*Page 0*/
			39 01 00 00 00 00 02 B0 00
			39 01 00 00 00 00 02 B6 03
			39 01 00 00 00 00 02 BA 87
			39 01 00 00 00 00 02 BF 1F
			39 01 00 00 00 00 02 C0 0F
			39 01 00 00 00 00 02 C2 0C
			39 01 00 00 00 00 02 C3 02
			39 01 00 00 00 00 02 C4 0C
			39 01 00 00 00 00 02 C5 02
/*Page 2: Gamma setting*/
			39 01 00 00 00 00 02 B0 02
			39 01 00 00 00 00 02 C0 00
			39 01 00 00 00 00 02 C1 0F
			39 01 00 00 00 00 02 C2 1A
			39 01 00 00 00 00 02 C3 2B
			39 01 00 00 00 00 02 C4 38
			39 01 00 00 00 00 02 C5 39
			39 01 00 00 00 00 02 C6 38
			39 01 00 00 00 00 02 C7 38
			39 01 00 00 00 00 02 C8 36
			39 01 00 00 00 00 02 C9 34
			39 01 00 00 00 00 02 CA 35
			39 01 00 00 00 00 02 CB 36
			39 01 00 00 00 00 02 CC 39
			39 01 00 00 00 00 02 CD 2D
			39 01 00 00 00 00 02 CE 2E
			39 01 00 00 00 00 02 CF 2F
			39 01 00 00 00 00 02 D0 07
			39 01 00 00 00 00 02 D2 00
			39 01 00 00 00 00 02 D3 0F
			39 01 00 00 00 00 02 D4 1A
			39 01 00 00 00 00 02 D5 2B
			39 01 00 00 00 00 02 D6 38
			39 01 00 00 00 00 02 D7 39
			39 01 00 00 00 00 02 D8 38
			39 01 00 00 00 00 02 D9 38
			39 01 00 00 00 00 02 DA 36
			39 01 00 00 00 00 02 DB 34
			39 01 00 00 00 00 02 DC 35
			39 01 00 00 00 00 02 DD 36
			39 01 00 00 00 00 02 DE 39
			39 01 00 00 00 00 02 DF 2D
			39 01 00 00 00 00 02 E0 2E
			39 01 00 00 00 00 02 E1 2F
			39 01 00 00 00 00 02 E2 07
/*Page 4: pwm*/
			39 01 00 00 00 00 02 B0 04
			39 01 00 00 00 00 02 B5 02
			39 01 00 00 00 00 02 B6 02			
/*Page 5: MIPI timing*/
			39 01 00 00 00 00 02 B0 05
			39 01 00 00 00 00 02 B3 52
/*Page 6: GOE setting*/
			39 01 00 00 00 00 02 B0 06
			39 01 00 00 00 00 02 B8 A5
			39 01 00 00 00 00 02 C0 A5
/*Gamma chopper control*/
			39 01 00 00 00 00 02 BC 33
/*VCCIF and VCC adjustment*/
			39 01 00 00 00 00 02 C7 0F
/*GOE: 3us*/
			39 01 00 00 00 00 02 D5 32
/*DGC setting
Red Positive gamma*/
			39 01 00 00 00 00 02 B0 07
			39 01 00 00 00 00 02 B1 00
			39 01 00 00 00 00 02 B2 04
			39 01 00 00 00 00 02 B3 0A
			39 01 00 00 00 00 02 B4 1A
			39 01 00 00 00 00 02 B5 29
			39 01 00 00 00 00 02 B6 38
			39 01 00 00 00 00 02 B7 5A
			39 01 00 00 00 00 02 B8 79
			39 01 00 00 00 00 02 B9 BF
			39 01 00 00 00 00 02 BA 05
			39 01 00 00 00 00 02 BB 88
			39 01 00 00 00 00 02 BC 14
			39 01 00 00 00 00 02 BD 18
			39 01 00 00 00 00 02 BE 97
			39 01 00 00 00 00 02 BF 11
			39 01 00 00 00 00 02 C0 4B
			39 01 00 00 00 00 02 C1 82
			39 01 00 00 00 00 02 C2 9B
			39 01 00 00 00 00 02 C3 B6
			39 01 00 00 00 00 02 C4 C3
			39 01 00 00 00 00 02 C5 D0
			39 01 00 00 00 00 02 C6 DB
			39 01 00 00 00 00 02 C7 E1
			39 01 00 00 00 00 02 C8 E4
			39 01 00 00 00 00 02 C9 00
			39 01 00 00 00 00 02 CA 00
			39 01 00 00 00 00 02 CB 16
			39 01 00 00 00 00 02 CC AF
			39 01 00 00 00 00 02 CD FF
			39 01 00 00 00 00 02 CE FF
/*DGC setting
Green Positive gamma*/
			39 01 00 00 00 00 02 B0 08
			39 01 00 00 00 00 02 B1 00
			39 01 00 00 00 00 02 B2 03
			39 01 00 00 00 00 02 B3 0A
			39 01 00 00 00 00 02 B4 1A
			39 01 00 00 00 00 02 B5 29
			39 01 00 00 00 00 02 B6 38
			39 01 00 00 00 00 02 B7 5A
			39 01 00 00 00 00 02 B8 7A
			39 01 00 00 00 00 02 B9 C1
			39 01 00 00 00 00 02 BA 07
			39 01 00 00 00 00 02 BB 8B
			39 01 00 00 00 00 02 BC 17
			39 01 00 00 00 00 02 BD 1B
			39 01 00 00 00 00 02 BE 99
			39 01 00 00 00 00 02 BF 13
			39 01 00 00 00 00 02 C0 4C
			39 01 00 00 00 00 02 C1 84
			39 01 00 00 00 00 02 C2 9D
			39 01 00 00 00 00 02 C3 B7
			39 01 00 00 00 00 02 C4 C4
			39 01 00 00 00 00 02 C5 D0
			39 01 00 00 00 00 02 C6 DB
			39 01 00 00 00 00 02 C7 E1
			39 01 00 00 00 00 02 C8 E4
			39 01 00 00 00 00 02 C9 00
			39 01 00 00 00 00 02 CA 00
			39 01 00 00 00 00 02 CB 16
			39 01 00 00 00 00 02 CC AF
			39 01 00 00 00 00 02 CD FF
			39 01 00 00 00 00 02 CE FF
/*DGC setting
Blue Positive gamma*/
			39 01 00 00 00 00 02 B0 09
			39 01 00 00 00 00 02 B1 04
			39 01 00 00 00 00 02 B2 04
			39 01 00 00 00 00 02 B3 09
			39 01 00 00 00 00 02 B4 1A
			39 01 00 00 00 00 02 B5 2B
			39 01 00 00 00 00 02 B6 3A
			39 01 00 00 00 00 02 B7 5D
			39 01 00 00 00 00 02 B8 80
			39 01 00 00 00 00 02 B9 CA
			39 01 00 00 00 00 02 BA 13
			39 01 00 00 00 00 02 BB 9D
			39 01 00 00 00 00 02 BC 30
			39 01 00 00 00 00 02 BD 34
			39 01 00 00 00 00 02 BE BB
			39 01 00 00 00 00 02 BF 30
			39 01 00 00 00 00 02 C0 6A
			39 01 00 00 00 00 02 C1 A1
			39 01 00 00 00 00 02 C2 BC
			39 01 00 00 00 00 02 C3 D4
			39 01 00 00 00 00 02 C4 E0
			39 01 00 00 00 00 02 C5 EB
			39 01 00 00 00 00 02 C6 F6
			39 01 00 00 00 00 02 C7 FA
			39 01 00 00 00 00 02 C8 FC
			39 01 00 00 00 00 02 C9 00
			39 01 00 00 00 00 02 CA 00
			39 01 00 00 00 00 02 CB 16
			39 01 00 00 00 00 02 CC AF
			39 01 00 00 00 00 02 CD FF
			39 01 00 00 00 00 02 CE FF

/*DGC setting
Red  Negative gamma*/
			39 01 00 00 00 00 02 B0 0A
			39 01 00 00 00 00 02 B1 00
			39 01 00 00 00 00 02 B2 04
			39 01 00 00 00 00 02 B3 0A
			39 01 00 00 00 00 02 B4 1A
			39 01 00 00 00 00 02 B5 29
			39 01 00 00 00 00 02 B6 38
			39 01 00 00 00 00 02 B7 5A
			39 01 00 00 00 00 02 B8 79
			39 01 00 00 00 00 02 B9 BF
			39 01 00 00 00 00 02 BA 05
			39 01 00 00 00 00 02 BB 88
			39 01 00 00 00 00 02 BC 14
			39 01 00 00 00 00 02 BD 18
			39 01 00 00 00 00 02 BE 97
			39 01 00 00 00 00 02 BF 11
			39 01 00 00 00 00 02 C0 4B
			39 01 00 00 00 00 02 C1 82
			39 01 00 00 00 00 02 C2 9B
			39 01 00 00 00 00 02 C3 B6
			39 01 00 00 00 00 02 C4 C3
			39 01 00 00 00 00 02 C5 D0
			39 01 00 00 00 00 02 C6 DB
			39 01 00 00 00 00 02 C7 E1
			39 01 00 00 00 00 02 C8 E4
			39 01 00 00 00 00 02 C9 00
			39 01 00 00 00 00 02 CA 00
			39 01 00 00 00 00 02 CB 16
			39 01 00 00 00 00 02 CC AF
			39 01 00 00 00 00 02 CD FF
			39 01 00 00 00 00 02 CE FF
/*DGC setting
Green  Negative gamma*/
			39 01 00 00 00 00 02 B0 0B
			39 01 00 00 00 00 02 B1 00
			39 01 00 00 00 00 02 B2 03
			39 01 00 00 00 00 02 B3 0A
			39 01 00 00 00 00 02 B4 1A
			39 01 00 00 00 00 02 B5 29
			39 01 00 00 00 00 02 B6 38
			39 01 00 00 00 00 02 B7 5A
			39 01 00 00 00 00 02 B8 7A
			39 01 00 00 00 00 02 B9 C1
			39 01 00 00 00 00 02 BA 07
			39 01 00 00 00 00 02 BB 8B
			39 01 00 00 00 00 02 BC 17
			39 01 00 00 00 00 02 BD 1B
			39 01 00 00 00 00 02 BE 99
			39 01 00 00 00 00 02 BF 13
			39 01 00 00 00 00 02 C0 4C
			39 01 00 00 00 00 02 C1 84
			39 01 00 00 00 00 02 C2 9D
			39 01 00 00 00 00 02 C3 B7
			39 01 00 00 00 00 02 C4 C4
			39 01 00 00 00 00 02 C5 D0
			39 01 00 00 00 00 02 C6 DB
			39 01 00 00 00 00 02 C7 E1
			39 01 00 00 00 00 02 C8 E4
			39 01 00 00 00 00 02 C9 00
			39 01 00 00 00 00 02 CA 00
			39 01 00 00 00 00 02 CB 16
			39 01 00 00 00 00 02 CC AF
			39 01 00 00 00 00 02 CD FF
			39 01 00 00 00 00 02 CE FF
/*DGC setting
Blue  Negative gamma*/
			39 01 00 00 00 00 02 B0 0C
			39 01 00 00 00 00 02 B1 04
			39 01 00 00 00 00 02 B2 04
			39 01 00 00 00 00 02 B3 09
			39 01 00 00 00 00 02 B4 1A
			39 01 00 00 00 00 02 B5 2B
			39 01 00 00 00 00 02 B6 3A
			39 01 00 00 00 00 02 B7 5D
			39 01 00 00 00 00 02 B8 80
			39 01 00 00 00 00 02 B9 CA
			39 01 00 00 00 00 02 BA 13
			39 01 00 00 00 00 02 BB 9D
			39 01 00 00 00 00 02 BC 30
			39 01 00 00 00 00 02 BD 34
			39 01 00 00 00 00 02 BE BB
			39 01 00 00 00 00 02 BF 30
			39 01 00 00 00 00 02 C0 6A
			39 01 00 00 00 00 02 C1 A1
			39 01 00 00 00 00 02 C2 BC
			39 01 00 00 00 00 02 C3 D4
			39 01 00 00 00 00 02 C4 E0
			39 01 00 00 00 00 02 C5 EB
			39 01 00 00 00 00 02 C6 F6
			39 01 00 00 00 00 02 C7 FA
			39 01 00 00 00 00 02 C8 FC
			39 01 00 00 00 00 02 C9 00
			39 01 00 00 00 00 02 CA 00
			39 01 00 00 00 00 02 CB 16
			39 01 00 00 00 00 02 CC AF
			39 01 00 00 00 00 02 CD FF
			39 01 00 00 64 00 02 CE FF /*delay 100ms*/
		];

		qcom,mdss-dsi-off-command = [
			39 01 00 00 00 00 02 B0 00
			39 01 00 00 64 00 02 B2 00	/* wait 100ms */
		];

		//qcom,mdss-dsi-post-panel-on-command = ;

		//qcom,cmd-sync-wait-broadcast = ;
		//qcom,mdss-dsi-fbc-enable = ;
		//qcom,mdss-dsi-fbc-slice-height = ;
		//qcom,mdss-dsi-fbc-2d-pred-mode = ;
		//qcom,mdss-dsi-fbc-ver2-mode = ;
		//qcom,mdss-dsi-fbc-bpp = ;
		//qcom,mdss-dsi-fbc-packing = ;
		//qcom,mdss-dsi-fbc-quant-error = ;
		//qcom,mdss-dsi-fbc-bias = ;
		//qcom,mdss-dsi-fbc-pat-mode = ;
		//qcom,mdss-dsi-fbc-vlc-mode = ;
		//qcom,mdss-dsi-fbc-bflc-mode = ;
		//qcom,mdss-dsi-fbc-h-line-budget = ;
		//qcom,mdss-dsi-fbc-budget-ctrl = ;
		//qcom,mdss-dsi-fbc-block-budget = ;
		//qcom,mdss-dsi-fbc-lossless-threshold = ;
		//qcom,mdss-dsi-fbc-lossy-threshold = ;
		//qcom,mdss-dsi-fbc-rgb-threshold = ;
		//qcom,mdss-dsi-fbc-lossy-mode-idx = ;
		//qcom,mdss-dsi-fbc-max-pred-err = ;
		qcom,mdss-dsi-h-left-border = <0>;
		qcom,mdss-dsi-h-right-border = <0>;
		qcom,mdss-dsi-v-top-border = <0>;
		qcom,mdss-dsi-v-bottom-border = <0>;
		qcom,mdss-dsi-underflow-color = <0xff>;
		qcom,mdss-dsi-border-color = <0>;
		//qcom,mdss-dsi-pan-enable-dynamic-fps = ;
		//qcom,mdss-dsi-pan-fps-update = ;
		//qcom,min-refresh-rate = ;
		//qcom,max-refresh-rate = ;
		qcom,mdss-dsi-bl-pmic-control-type = "bl_ctrl_dcs";
		//qcom,mdss-dsi-bl-pwm-pmi = ;
		//qcom,mdss-dsi-bl-pmic-bank-select = ;
		//qcom,mdss-dsi-bl-pmic-pwm-frequency = ;
		//qcom,mdss-dsi-pwm-gpio = ;
		qcom,mdss-dsi-bl-min-level = <1>;
		qcom,mdss-dsi-bl-max-level = <256>;
		qcom,mdss-brightness-max-level = <256>;
		//qcom,mdss-dsi-interleave-mode = ;
		qcom,mdss-dsi-panel-type = "dsi_video_mode";
		//qcom,5v-boost-gpio = ;
		//qcom,mdss-dsi-te-check-enable = ;
		//qcom,mdss-dsi-te-using-te-pin = ;
		//qcom,mdss-dsi-te-pin-select = ;
		//qcom,mdss-dsi-te-dcs-command = ;
		//qcom,mdss-dsi-wr-mem-start = ;
		//qcom,mdss-dsi-wr-mem-continue = ;
		qcom,mdss-dsi-h-sync-pulse = <0>;
		//qcom,mdss-dsi-hfp-power-mode;
		//qcom,mdss-dsi-hbp-power-mode;
		//qcom,mdss-dsi-hsa-power-mode;
		//qcom,mdss-dsi-last-line-interleave = ;
		qcom,mdss-dsi-bllp-eof-power-mode;
		qcom,mdss-dsi-bllp-power-mode;
		qcom,mdss-dsi-traffic-mode = "burst_mode";
		qcom,mdss-dsi-pixel-packing = "loose";
		qcom,mdss-dsi-virtual-channel-id = <0>;
		qcom,mdss-dsi-color-order = <0>;
		qcom,mdss-dsi-lane-0-state;
		qcom,mdss-dsi-lane-1-state;
		qcom,mdss-dsi-lane-2-state;
		qcom,mdss-dsi-lane-3-state;
		qcom,mdss-dsi-stream = <0>;
		qcom,mdss-dsi-mdp-trigger = "none";
		qcom,mdss-dsi-dma-trigger = "trigger_sw";
		//qcom,mdss-mdp-transfer-time-us = ;
		//qcom,mdss-dsi-post-mode-switch-on-command-state = ;
		//qcom,mdss-dsi-panel-mode-gpio-state = ;
		//qcom,mdss-tear-check-disable = ;
		//qcom,mdss-tear-check-sync-cfg-height = ;
		//qcom,mdss-tear-check-sync-init-val = ;
		//qcom,mdss-tear-check-sync-threshold-start = ;
		//qcom,mdss-tear-check-sync-threshold-continue = ;
		//qcom,mdss-tear-check-start-pos = ;
		//qcom,mdss-tear-check-rd-ptr-trigger-intr = ;
		//qcom,mdss-tear-check-frame-rate = ;

		//qcom,partial-update-enabled = ;
		//qcom,mdss-dsi-horizontal-line-idle = ;
		//qcom,partial-update-roi-merge = ;
		//qcom,dcs-cmd-by-left = ;
		qcom,mdss-dsi-lp11-init;
		qcom,mdss-dsi-init-delay-us = <100>;
		qcom,mdss-dsi-rx-eot-ignore;
		qcom,mdss-dsi-tx-eot-append;
		//qcom,ulps-enabled = ;
		//qcom,suspend-ulps-enabled = ;
		//qcom,panel-roi-alignment = ;
		//qcom,esd-check-enabled = ;
		//qcom,mdss-dsi-panel-status-command = ;
		//qcom,mdss-dsi-panel-status-command-mode = ;
		//qcom,mdss-dsi-panel-status-check-mode = ;
		//qcom,mdss-dsi-panel-status-read-length = ;
		//qcom,mdss-dsi-panel-status-valid-params = ;
		//qcom,mdss-dsi-panel-status-value = ;
		//qcom,mdss-dsi-panel-max-error-count = ;
		//qcom,dynamic-mode-switch-enabled = ;
		//qcom,dynamic-mode-switch-type = ;
		//qcom,mdss-dsi-post-mode-switch-on-command = ;
		//qcom,video-to-cmd-mode-switch-commands = ;
		//qcom,cmd-to-video-mode-switch-commands = ;
		//qcom,mdss-dsi-panel-orientation = ;
		//qcom,panel-ack-disabled = ;
		//qcom,mdss-dsi-force-clock-lane-hs;
		//qcom,compression-mode = ;
		//qcom,panel-supply-entries = ;
		//qcom,config-select = ;
		//qcom,lm-split = ;
		//qcom,split-mode = ;
		//qcom,mdss-dsc-encoders = ;
		//qcom,mdss-dsc-slice-height = ;
		//qcom,mdss-dsc-slice-width = ;
		//qcom,mdss-dsc-slice-per-pkt = ;
		//qcom,mdss-dsc-bit-per-component = ;
		//qcom,mdss-dsc-bit-per-pixel = ;
		//qcom,mdss-dsc-block-prediction-enable = ;
		//qcom,mdss-dsc-config-by-manufacture-cmd = ;
		//qcom,dba-panel = ;
		//qcom,bridge-name = ;
		//qcom,adjust-timer-wakeup-ms = ;
		//qcom,mdss-dsi-display-timings = ;
		//qcom,mdss-dsi-timing-default = ;
		//qcom,mdss-dsi-timing-switch-command = ;
		//qcom,mdss-dsi-timing-switch-command-state  = ;

/*
 * ************************************************************************************************************************************
 *
 *
 *			Below  parameters are samsung dependent thigs
 *
 *
 * ************************************************************************************************************************************
 */
		samsung,panel-vendor = "BOE";
		samsung,tft-module-name = "82790D";
		samsung,tft-common-support;

		samsung,manufacture_id0_rx_cmds_revA = [06 01 00 00 00 00 01 da 01 00];
		samsung,manufacture_id1_rx_cmds_revA = [06 01 00 00 00 00 01 db 01 00];
		samsung,manufacture_id2_rx_cmds_revA = [06 01 00 00 00 00 01 dc 01 00];

		samsung,tft_pwm_tx_cmds_revA=[
			39 01 00 00 00 00 02 B0 04
			39 01 00 00 00 00 02 B8 00
		];
		/*
		* ************************************************************************************************************************
		* Scaled level to index mappings
		* ************************************************************************************************************************
		*/
		samsung,candela_map_table_revA = <
		/*<idx>	  <from>  <till> <scaled_level> */
		    0    0    0    0
		    1    1    1    1
		    2    2    2    2
		    3    3    3    3
		    4    4    4    4
		    5    5    5    5
		    6    6    6    6
		    7    7    7    7
		    8    8    8    8
		    9    9    9    9
		    10   10   10   10
		    11   11   11   11
		    12   12   12   12
		    13   13   13   13
		    14   14   14   14
		    15   15   15   15
		    16   16   16   16
		    17   17   17   17
		    18   18   18   18
		    19   19   19   19
		    20   20   20   20
		    21   21   21   21
		    22   22   22   22
		    23   23   23   23
		    24   24   24   24
		    25   25   25   25
		    26   26   26   26
		    27   27   27   27
		    28   28   28   28
		    29   29   29   29
		    30   30   30   30
		    31   31   31   31
		    32   32   32   32
		    33   33   33   33
		    34   34   34   34
		    35   35   35   35
		    36   36   36   36
		    37   37   37   37
		    38   38   38   38
		    39   39   39   39
		    40   40   40   40
		    41   41   41   41
		    42   42   42   42
		    43   43   43   43
		    44   44   44   44
		    45   45   45   45
		    46   46   46   46
		    47   47   47   47
		    48   48   48   48
		    49   49   49   49
		    50   50   50   50
		    51   51   51   51
		    52   52   52   52
		    53   53   53   53
		    54   54   54   54
		    55   55   55   55
		    56   56   56   56
		    57   57   57   57
		    58   58   58   58
		    59   59   59   59
		    60   60   60   60
		    61   61   61   61
		    62   62   62   62
		    63   63   63   63
		    64   64   64   64
		    65   65   65   65
		    66   66   66   66
		    67   67   67   67
		    68   68   68   68
		    69   69   69   69
		    70   70   70   70
		    71   71   71   71
		    72   72   72   72
		    73   73   73   73
		    74   74   74   74
		    75   75   75   75
		    76   76   76   76
		    77   77   77   77
		    78   78   78   78
		    79   79   79   79
		    80   80   80   80
		    81   81   81   81
		    82   82   82   82
		    83   83   83   83
		    84   84   84   84
		    85   85   85   85
		    86   86   86   86
		    87   87   87   87
		    88   88   88   88
		    89   89   89   89
		    90   90   90   90
		    91   91   91   91
		    92   92   92   92
		    93   93   93   93
		    94   94   94   94
		    95   95   95   95
		    96   96   96   96
		    97   97   97   97
		    98   98   98   98
		    99   99   99   99
		    100  100  100  100
		    101  101  101  101
		    102  102  102  102
		    103  103  103  103
		    104  104  104  104
		    105  105  105  105
		    106  106  106  106
		    107  107  107  107
		    108  108  108  108
		    109  109  109  109
		    110  110  110  110
		    111  111  111  111
		    112  112  112  112
		    113  113  113  113
		    114  114  114  114
		    115  115  115  115
		    116  116  116  116
		    117  117  117  117
		    118  118  118  118
		    119  119  119  119
		    120  120  120  120
		    121  121  121  121
		    122  122  122  122
		    123  123  123  123
		    124  124  124  124
		    125  125  125  125
		    126  126  126  126
		    127  127  127  127
		    128  128  128  128
		    129  129  129  129
		    130  130  130  130
		    131  131  131  131
		    132  132  132  132
		    133  133  133  133
		    134  134  134  134
		    135  135  135  135
		    136  136  136  136
		    137  137  137  137
		    138  138  138  138
		    139  139  139  139
		    140  140  140  140
		    141  141  141  141
		    142  142  142  142
		    143  143  143  143
		    144  144  144  144
		    145  145  145  145
		    146  146  146  146
		    147  147  147  147
		    148  148  148  148
		    149  149  149  149
		    150  150  150  150
		    151  151  151  151
		    152  152  152  152
		    153  153  153  153
		    154  154  154  154
		    155  155  155  155
		    156  156  156  156
		    157  157  157  157
		    158  158  158  158
		    159  159  159  159
		    160  160  160  160
		    161  161  161  161
		    162  162  162  162
		    163  163  163  163
		    164  164  164  164
		    165  165  165  165
		    166  166  166  166
		    167  167  167  167
		    168  168  168  168
		    169  169  169  169
		    170  170  170  170
		    171  171  171  171
		    172  172  172  172
		    173  173  173  173
		    174  174  174  174
		    175  175  175  175
		    176  176  176  176
		    177  177  177  177
		    178  178  178  178
		    179  179  179  179
		    180  180  180  180
		    181  181  181  181
		    182  182  182  182
		    183  183  183  183
		    184  184  184  184
		    185  185  185  185
		    186  186  186  186
		    187  187  187  187
		    188  188  188  188
		    189  189  189  189
		    190  190  190  190
		    191  191  191  191
		    192  192  192  192
		    193  193  193  193
		    194  194  194  194
		    195  195  195  195
		    196  196  196  196
		    197  197  197  197
		    198  198  198  198
		    199  199  199  199
		    200  200  200  200
		    201  201  201  201
		    202  202  202  202
		    203  203  203  203
		    204  204  204  204
		    205  205  205  205
		    206  206  206  206
		    207  207  207  207
		    208  208  208  208
		    209  209  209  209
		    210  210  210  210
		    211  211  211  211
		    212  212  212  212
		    213  213  213  213
		    214  214  214  214
		    215  215  215  215
		    216  216  216  216
		    217  217  217  217
		    218  218  218  218
		    219  219  219  219
		    220  220  220  220
		    221  221  221  221
		    222  222  222  222
		    223  223  223  223
		    224  224  224  224
		    225  225  225  225
		    226  226  226  226
		    227  227  227  227
		    228  228  228  228
		    229  229  229  229
		    230  230  230  230
		    231  231  231  231
		    232  232  232  232
		    233  233  233  233
		    234  234  234  234
		    235  235  235  235
		    236  236  236  236
		    237  237  237  237
		    238  238  238  238
		    239  239  239  239
		    240  240  240  240
		    241  241  241  241
		    242  242  242  242
		    243  243  243  243
		    244  244  244  244
		    245  245  245  245
		    246  246  246  246
		    247  247  247  247
		    248  248  248  248
		    249  249  249  249
		    250  250  250  250
		    251  251  251  251
		    252  252  252  252
		    253  253  253  253
		    254  254  254  254
		    255  255  255  255
		    256  256  256  255
		>;
	};
};

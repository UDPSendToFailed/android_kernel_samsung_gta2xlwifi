## arch/arm64/Kconfig.sec
```kconfig
config SEC_GTA2XLLTE_PROJECT
	depends on ARCH_SDM450
	default n
	bool "Samsung Tab A2 XL LTE Project"
	help
	  Support for Samsung Tab A2 XL LTE Project

config MACH_GTA2XLLTE_EUR_OPEN
	depends on SEC_GTA2XLLTE_PROJECT
	default n
	bool "Samsung Tab A2 XL LTE EUR OPEN"
	help
	  Support for Samsung Tab A2 XL LTE EUR OPEN device.

config SEC_GTA2XLWIFI_PROJECT
	depends on ARCH_SDM450
	default n
	bool "Samsung Tab A2 XL WIFI Project"
	help
	  Support for Samsung Tab A2 XL WIFI Project

config MACH_GTA2XLWIFI_EUR_OPEN
	depends on SEC_GTA2XLWIFI_PROJECT
	default n
	bool "Samsung Tab A2 XL WIFI EUR OPEN"
	help
	  Support for Samsung Tab A2 XL WIFI EUR OPEN device.
```

## drivers/input/touchscreen/stm/fts1ba90a/Kconfig
```kconfig
#
# STMicroelectronics TOUCH driver configuration
#

config TOUCHSCREEN_FTS1BA90A
	tristate "STMicroelectronics i2c multitouch touchscreen with FingerTipS"
	depends on I2C
	help
		Say Y here to enable STMicroelectronics touchscreen support.
		If unsure, say N.
		To compile this driver as a module, choose M here: the
		module will be called STM_ts.
config SECURE_TOUCH
        bool "Secure Touch support"
        depends on TOUCHSCREEN_FTS1BA90A
        help
          Enable secure touch support for TrustZone-secured
          touchscreen communication.

config INPUT_TOUCHSCREEN_TCLMV2
        bool "TCL Module Versioning V2"
        depends on TOUCHSCREEN_FTS1BA90A
        help
          Enable TCL Module Versioning V2 for touchscreen calibration.
```

## drivers/samsung/Kconfig
```kconfig
config SAMSUNG_PRODUCT_SHIP
	bool "set up for product shipping"
	default n

config SEC_BSP
	bool "Samsung BSP Feature"
	default n
	help
	  Samsung BSP Feature.

config DRV_SAMSUNG
	bool "Samsung sec class/sysfs Feature"
	default n
	help
	  Samsung sysfs name 'sec' directory create
```

## drivers/staging/samsung/Kconfig
```kconfig
menu "Samsung staging drivers"

source "drivers/staging/samsung/sec_notifier/Kconfig"

endmenu
```
